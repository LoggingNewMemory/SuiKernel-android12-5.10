## net/ipv4/Kconfig.rej
```kconfig
--- net/ipv4/Kconfig
+++ net/ipv4/Kconfig
@@ -761,6 +782,7 @@ config DEFAULT_TCP_CONG
 	default "dctcp" if DEFAULT_DCTCP
 	default "cdg" if DEFAULT_CDG
 	default "bbr" if DEFAULT_BBR
+	default "bbr3" if DEFAULT_BBR3
 	default "cubic"
 
 config TCP_MD5SIG
```
